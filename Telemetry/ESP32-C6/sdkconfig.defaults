## Telemetry/ESP32-C6/sdkconfig.defaults
```kconfig
# Force console output via UART0 (USB-UART bridge = /dev/ttyUSB0)
CONFIG_ESP_CONSOLE_UART_DEFAULT=y
CONFIG_ESP_CONSOLE_UART_NUM=0
CONFIG_ESP_CONSOLE_UART_BAUDRATE=115200

# Flash size 2MB (matches your actual chip)
CONFIG_ESPTOOLPY_FLASHSIZE_2MB=y

# ───────── BLE NimBLE ─────────
CONFIG_BT_ENABLED=y
CONFIG_BT_NIMBLE_ENABLED=y
CONFIG_BT_NIMBLE_ROLE_PERIPHERAL=y
CONFIG_BT_NIMBLE_ROLE_CENTRAL=n
CONFIG_BT_NIMBLE_ROLE_OBSERVER=n
CONFIG_BT_NIMBLE_ROLE_BROADCASTER=y
CONFIG_BT_NIMBLE_MAX_CONNECTIONS=1
CONFIG_BT_NIMBLE_DEVICE_NAME="GreenHouse-C6"
```
